## Firmware/ZMK/boards/shields/Skofboard/Kconfig.defconfig
```kconfig
if SKOFBOARD_LEFT

config ZMK_KEYBOARD_NAME
    default "Skofboard"

config ZMK_SPLIT_ROLE_CENTRAL
    default y

endif

if SKOFBOARD_LEFT || SKOFBOARD_RIGHT

config ZMK_SPLIT
    default y

endif
```

## Firmware/ZMK/boards/shields/Skofboard/Kconfig.shield
```kconfig
config SKOFBOARD_LEFT
    def_bool $(shields_list_contains,Skofboard_left)

config SKOFBOARD_RIGHT
    def_bool $(shields_list_contains,Skofboard_right)
```
